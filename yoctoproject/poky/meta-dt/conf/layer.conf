## yoctoproject/poky/meta-dt/conf/layer.conf
```bitbake
# We have a conf and classes directory, add to BBPATH
BBPATH .= ":${LAYERDIR}"

# We have recipes-* directories, add to BBFILES
BBFILES += "${LAYERDIR}/recipes-*/*/*.bb \
            ${LAYERDIR}/recipes-*/*/*.bbappend"

BBFILE_COLLECTIONS += "meta-dt"
BBFILE_PATTERN_meta-dt = "^${LAYERDIR}/"
BBFILE_PRIORITY_meta-dt = "6"

LAYERDEPENDS_meta-dt = "core"
LAYERSERIES_COMPAT_meta-dt = "kirkstone"
```

## yoctoproject/poky/meta-mykernel/conf/layer.conf
```bitbake
# We have a conf and classes directory, add to BBPATH
BBPATH .= ":${LAYERDIR}"

# We have recipes-* directories, add to BBFILES
BBFILES += "${LAYERDIR}/recipes-*/*/*.bb \
            ${LAYERDIR}/recipes-*/*/*.bbappend"

BBFILE_COLLECTIONS += "meta-mykernel"
BBFILE_PATTERN_meta-mykernel = "^${LAYERDIR}/"
BBFILE_PRIORITY_meta-mykernel = "6"

LAYERDEPENDS_meta-mykernel = "core"
LAYERSERIES_COMPAT_meta-mykernel = "kirkstone"
```
